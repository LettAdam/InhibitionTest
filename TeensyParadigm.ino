#include <Bounce2.h>  // Used to eliminate false states of pressure
                      // generated by the vibration of button switches during
                      // their actuation. Courtesy of Thomas Fredericks.

// Define global variables

  // LED and Button pinouts
  #define LED1  2
  #define LED2  3
  #define LED3  4

  #define BUTTON1  6
  #define BUTTON2  7
  #define BUTTON3  5

  // Variables
  int targetChoice = 0; //integer to select target (0=right, 1=left)
  int success;
  int pressed;
  int initia = 0;
  int goal = 0;
  int target_has_switched = 0;
  int scvar;

  unsigned long t0; 
  unsigned long t1;
  unsigned long tdelay; 
  unsigned long switchtime;
  unsigned long b0;
  unsigned long b1;

// Creation of bounce instances for each button.
  Bounce button1 = Bounce(); 
  Bounce button2 = Bounce();
  Bounce button3 = Bounce(); 
 
void setup() {

   // put your setup code here, to run once:

   // Initiate the serial connection (to communicate with the computer)

   Serial.begin(115200);
   while (!Serial) {
     ; // wait for serial port to connect. Needed for native USB
   }
 
  // Initiate the LEDs.
   pinMode(LED1, OUTPUT); // Left
   pinMode(LED2, OUTPUT); // Right
   pinMode(LED3, OUTPUT); // Center

   // Initiate the buttons and tie them to bounce instances.
   button1.attach(BUTTON1,INPUT_PULLUP);  // Left answer button
   button1.interval(5); 
   button2.attach(BUTTON2,INPUT_PULLUP);  // Right answser button
   button2.interval(5); 
   button3.attach(BUTTON3,INPUT_PULLUP);  // Central instruction button
   button3.interval(5); 
 }
 
void sendToComputer(int val1, int val2, int val3) {
 }
 
void SwitchLED(bool L1, bool L2, bool L3){  // For an easier change of LED states.
   digitalWrite(LED1, L1);
   digitalWrite(LED2, L2);
   digitalWrite(LED3, L3); 
 }
 
void trial(){

  // Instruction, answer layout and switch time generation.
  goal = random(0,2); 
  targetChoice=random(0,2);
  switchtime = random(75,200);
  
  // Latencies and switch indicator reinitialization.
  t0=0;
  t1=0;
  tdelay = millis();
  initia = 0; //Instruction switch indicator.

  SwitchLED(0,0,1); // Light up the central button to signal the beginning of trial.

  while (true){

    // Checks the button's state.
    button3.update();             

    if ( button3.fell() ) {       // Button press.
      t0=millis();
      b0=millis();

      if (initia == 0) {          // Sets up the answer layout.
        target_has_switched = 0;
        if (targetChoice==1){
          SwitchLED(1,0,goal);
        } else{
          SwitchLED(0,1,goal);
        }
        initia = 1;
        tdelay = millis();
      }
     } else if ( button3.rose() ) { // Leaves the loop after release.
        initia = 2;
        b1 = millis() - b0;
        break;       
     }
    
    if (initia == 1) {
      if ((millis() - tdelay) > switchtime) {
          initia = 2;
          target_has_switched = 1;  // Switches the instruction if the switch time was 
          if (targetChoice==1){     // generated inside the button press interval.
            SwitchLED(1,0, 1 - goal);
          } else{
            SwitchLED(0,1, 1 - goal);
          }
        }
     }
}


  while (true){
    button1.update();
    button2.update();

  // Reports which answer button was pressed and compares it 
  // with the instruction to heck if the trial was successful.
    if (button1.fell()){
      t1 = millis() - t0;
      pressed = 1;  
      if (digitalRead(LED1) == digitalRead(LED3)){
        success = 1;
        break;
      }else{
        success = 0;
        break;
      }

    }else if (button2.fell()){
      t1 = millis() - t0;
      pressed = 2;
      if (digitalRead(LED2) == digitalRead(LED3)){
        success = 1;
        break;
      }else{
       success = 0;
       break;
       }
      }
    }

  // Prints out latencies.
    Serial.print(b1);
    Serial.print(" ");
    Serial.print(t1);
    Serial.print(" ");
  // Instruction, whether it has switched and the time of switching.
    Serial.print(goal);
    Serial.print(" ");
    Serial.print(target_has_switched);
    Serial.print(" ");
    Serial.print(switchtime);
    Serial.print(" ");
  // LED states (post switch if one occured).
    Serial.print(digitalRead(LED1));
    Serial.print(" ");
    Serial.print(digitalRead(LED2));
    Serial.print(" ");
    Serial.print(digitalRead(LED3));
    Serial.print(" ");
  // The pressed Answer and wether the trial was a success.
    Serial.print(pressed);
    Serial.print(" ");
    Serial.print(success);
    Serial.println("");

  SwitchLED(0,0,0); // Resets the LEDs.
}


 void loop() {
   trial();
   delay(50);
 }
